/dts-v1/;

/{
    firmware {
        android {
            compatible = "android,firmware";
            host.vbmeta.device_state = "unlocked";
            host.vbmeta.digest = "0000000000000000000000000000000000000000000000000000000000000000";
            host.vbmeta.public_key_digest = "0000000000000000000000000000000000000000000000000000000000000000";
            host.verifiedbootstate = "orange";
        };
    };
};
