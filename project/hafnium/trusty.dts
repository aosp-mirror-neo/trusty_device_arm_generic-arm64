/dts-v1/;

/ {
    compatible = "arm,ffa-manifest-1.0";
    ffa-version = <0x00010002>; /* 31:16 - Major, 15:0 - Minor */
    uuid = <0xf025ee40 0x4c30bca2 0x73a14c8c 0xf18a7dc5>,
           <0x9120b8c5 0xbb48fed4 0x244de7b7 0xbe28bb6e>;
    id = <1>;
    auxiliary-id = <0xaf>;
    description = "Trusty";

    /*
     * On EL3-SPMC we need to use exactly PLATFORM_CORE_COUNT.
     * Hafnium does not have that requirement, but we still
     * try to use the same value as SMP_MAX_CPUS.
     */
    execution-ctx-count = <32>;
    exception-level = <2>; /* S-EL1 */
    execution-state = <0>; /* AARCH64 */
    load-address = <0x10000000>;
    entrypoint-offset = <0x00004000>;
    xlat-granule = <0>; /* 4KiB */

    messaging-method = <0x00000201>; /* DIRECT_REQ and DIRECT_REQ2 message receive only */
    vm-availability-messages = <3>;

    ns-interrupts-action = <1>; /* Managed exit is supported */
    /* Trusty reschedules the current thread on an IRQ but not a FIQ */
    managed-exit-virq;

    boot-order = <0>;
};
